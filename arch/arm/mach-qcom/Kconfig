## arch/arm/mach-qcom/Kconfig
```kconfig
# SPDX-License-Identifier: GPL-2.0-only
menuconfig ARCH_QCOM
	bool "Qualcomm Support"
	depends on ARCH_MULTI_V7
	select ARM_GIC
	select ARM_AMBA
	select IOMMU_DMA
	select CLKSRC_QCOM
	select HAVE_ARM_ARCH_TIMER
	select PINCTRL
	select QCOM_SCM if SMP
	help
	  Support for Qualcomm's devicetree based systems.
	  This includes support for a few devices with ARM64 SoC, that have
	  ARM32 signed firmware that does not allow booting ARM64 kernels.

if ARCH_QCOM

config ARCH_IPQ40XX
	bool "Enable support for IPQ40XX"
	select CLKSRC_QCOM
	select HAVE_ARM_ARCH_TIMER

config ARCH_MSM8X60
	bool "Enable support for MSM8X60"
	select CLKSRC_QCOM

config ARCH_MSM8909
	bool "Enable support for MSM8909"
	select HAVE_ARM_ARCH_TIMER

config ARCH_MSM8916
	bool "Enable support for MSM8916"
	select HAVE_ARM_ARCH_TIMER
	select IOMMU_DMA

config ARCH_QCOM_RESERVE_SMEM
	bool "Reserve SMEM at the beginning of RAM"
	help
	  Reserve 2MB at the beginning of the System RAM for shared mem.
	  This is required on IPQ40xx, MSM8x60 and MSM8960 platforms.

endif
```
